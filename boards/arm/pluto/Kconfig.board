## boards/arm/pluto/Kconfig.board
```kconfig
# Analog Devices Pluto SDR board configuration

# Copyright (c) 2023 Brett Witherspoon
# SPDX-License-Identifier: Apache-2.0

config BOARD_PLUTO
	bool "Analog Devices Pluto SDR"
	depends on SOC_XILINX_XC7Z010
```

## boards/arm/pluto/Kconfig.defconfig
```kconfig
# Analog Devices Pluto SDR board

# Copyright (c) 2023 Brett Witherspoon
# SPDX-License-Identifier: Apache-2.0

if BOARD_PLUTO

config BOARD
	default "pluto"

endif # BOARD_PLUTO
```
